## src/platforms/esp32/components/atomvm_leds/Kconfig
```kconfig
menu "ATOMVM_LEDS Configuration"

config AVM_LEDS_ENABLE
	bool "Enable AtomVM LED chain driver"
	default y

endmenu
```

## src/platforms/esp32/components/atomvm_lvgl/Kconfig
```kconfig
menu "ATOMVM_LVGL Configuration"

config AVM_LVGL_ENABLE
	bool "Enable AtomVM LVGL display driver (spike)"
	default y

endmenu
```
